## security/digsig2/Kconfig
```kconfig
config SECURITY_DIGSIG2
	bool "Digital ELF Signatures support"
	depends on SECURITY
	depends on KEYS
	depends on ASYMMETRIC_KEY_TYPE
	default n
	help
	  This selects DigSig2, which limits execution of binaries to those
	  signed with predefined certificates. Further information can be
	  found in Documentation/admin-guide/LSM/DigSig2.rst.

	  If you are unsure how to answer this question, answer N.

if SECURITY_DIGSIG2
config SECURITY_DIGSIG2_TRUSTED_KEYS
	string "X.509 keys for DigSig2 keyring"
	help
	  If set, this option should be the filename of a PEM-formatted file
	  containing trusted X.509 certificates to be included in the DigSig2
	  trusted keyring.

config SECURITY_DIGSIG2_DEVELOP
	bool "DigSig2 Development Support"
	default y
	help
	  This enables the development support option of DigSig2,
	  which is useful for experimenting with DigSig and testing
	  signatures.  If unsure, say Y.  With this option enabled, the
	  kernel will start in permissive mode (log everything, deny nothing)
	  unless you specify enforcing=1 on the kernel command line.
endif
```
